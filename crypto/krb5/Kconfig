## crypto/krb5/Kconfig
```kconfig
config CRYPTO_KRB5
	tristate "Kerberos 5 crypto"
	select CRYPTO_MANAGER
	select CRYPTO_SKCIPHER
	select CRYPTO_HASH_INFO
	select CRYPTO_HMAC
	select CRYPTO_CMAC
	select CRYPTO_SHA1
	select CRYPTO_SHA256
	select CRYPTO_SHA512
	select CRYPTO_CBC
	select CRYPTO_CTS
	select CRYPTO_AES
	select CRYPTO_CAMELLIA
	help
	  Provide Kerberos-5-based security.

config CRYPTO_KRB5_SELFTESTS
	bool "Kerberos 5 crypto selftests"
	depends on CRYPTO_KRB5
```
